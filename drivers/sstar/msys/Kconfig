## drivers/sstar/msys/Kconfig
```kconfig
config MS_MSYS
    bool "msys api"
    default y
    
config MS_ZEN
    bool
    depends on MS_MSYS
    default y

config MS_MSYS_LOG
    bool "Log Redirection"
    depends on MS_MSYS
    default n

config MSYS_PERF_TEST
    bool "sysfs:perf test"
    depends on MS_MSYS
    default n

config MSYS_BENCH_MEMORY_FUNC
    bool "ioctl:bench memory function"
    depends on MS_MSYS
    default n

config MSYS_DMEM_SYSFS_ALL
    bool "add more dmem sysfs node"
    depends on MS_MSYS
    default n

config MSYS_DDR_SELFREFRESH_REBOOT
    bool "test for reboot with DDR selfrefresh"
    depends on MS_MSYS
    default n
```

## drivers/sstar/rtc/Kconfig
```kconfig
config MS_RTC
    bool "MS_RTC"
    default n
    help

config RTC_INNER
    select RTC_CLASS
        tristate "Mstar RTC driver"
        depends on MS_RTC
        default n
        help

config RTCPWC_INNER
    select RTC_CLASS
        tristate "Mstar RTCWC driver"
        depends on MS_RTC
        default y
        help
```

## drivers/usb/gadget/udc/msb250x/Kconfig
```kconfig
config USB_GADGET_MSB250X
        tristate "MSB250X USB Device Controller"
        help
                Mstar USB device

config USB_MSB250X
        tristate
        depends on USB_GADGET_MSB250X
        default USB_GADGET
        select USB_GADGET_SELECTED

config USB_MSB250X_DMA
        tristate "Use DMA for MSB250x USB"
                default y if USB_GADGET_MSB250X

config USB_MSB250X_DEBUG
        boolean "MSB250X udc debug messages"
        depends on USB_GADGET_MSB250X

config USB_MSB250X_PROC
        boolean "MSB250X udc proc system"
        depends on USB_GADGET_MSB250X && PROC_FS

config USB_MSB250X_FPGA
        boolean "MSB250X udc FPGA verification only"
        depends on USB_GADGET_MSB250X

config USB_CHARGER_DETECT
        boolean "MSB250X udc charger detection"
        depends on USB_GADGET_MSB250X
        #default y
```
