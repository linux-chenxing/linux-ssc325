/*
* pioneer3-padmux.dtsi- Sigmastar
*
* Copyright (c) [2019~2020] SigmaStar Technology.
*
*
* This software is licensed under the terms of the GNU General Public
* License version 2, as published by the Free Software Foundation, and
* may be copied, distributed, and modified under those terms.
*
* This program is distributed in the hope that it will be useful,
* but WITHOUT ANY WARRANTY; without even the implied warranty of
* MERCHANTABILITY or FITNESS FOR A PARTICULAR PURPOSE.  See the
* GNU General Public License version 2 for more details.
*
*/

#include <../../../../drivers/sstar/include/pioneer3/padmux.h>
#include <../../../../drivers/sstar/include/mdrv_puse.h>

/ {
    soc {
         padmux {
            compatible = "sstar-padmux";
            schematic =
                //<PAD_GPIO0  >,
                //pwm
                //<PAD_GPIO1 PINMUX_FOR_PWM0_MODE_10 MDRV_PUSE_PWM0>,
                <PAD_GPIO2 PINMUX_FOR_PWM1_MODE_10 MDRV_PUSE_PWM1>,
                <PAD_GPIO3 PINMUX_FOR_PWM2_MODE_10 MDRV_PUSE_PWM2>,
                <PAD_GPIO4 PINMUX_FOR_PWM3_MODE_10 MDRV_PUSE_PWM3>,
                //<PAD_KEY10 PINMUX_FOR_EJ_MODE_3 MDRV_PUSE_EJ_TCK>,
                //<PAD_KEY11 PINMUX_FOR_EJ_MODE_3 MDRV_PUSE_EJ_TMS>,
                //<PAD_KEY12 PINMUX_FOR_EJ_MODE_3 MDRV_PUSE_EJ_TDO>,
                //<PAD_KEY13 PINMUX_FOR_EJ_MODE_3 MDRV_PUSE_EJ_TDI>,



                #if 0
                //I2S Rx
                <PAD_GPIO3       PINMUX_FOR_I2S_RX_MODE_6     MDRV_PUSE_I2S_RX_WCK >,
                <PAD_GPIO4       PINMUX_FOR_I2S_RX_MODE_6     MDRV_PUSE_I2S_RX_BCK >,
                <PAD_GPIO5       PINMUX_FOR_I2S_RX_MODE_6     MDRV_PUSE_I2S_RX_SDI >,
                #endif
                #if 0
                //I2S Tx
                <PAD_GPIO6       PINMUX_FOR_I2S_TX_MODE_6     MDRV_PUSE_I2S_TX_SDO >,
                <PAD_GPIO7       PINMUX_FOR_I2S_TX_MODE_6     MDRV_PUSE_I2S_TX_BCK >,
                <PAD_GPIO8       PINMUX_FOR_I2S_TX_MODE_6     MDRV_PUSE_I2S_TX_WCK >,
                #endif
                #if 0
                //I2S MCK
                <PAD_GPIO2       PINMUX_FOR_I2S_MCK_MODE_7    MDRV_PUSE_AIO_MCK>,
                #endif
                #if 0
                //DMIC
                <PAD_KEY6        PINMUX_FOR_DMIC_MODE_3       MDRV_PUSE_DMIC_D1 >,
                <PAD_KEY7        PINMUX_FOR_DMIC_MODE_3       MDRV_PUSE_DMIC_D0 >,
                <PAD_KEY8        PINMUX_FOR_DMIC_MODE_3       MDRV_PUSE_DMIC_CLK >,
                #endif
                #if 0
                //sensor
                <PAD_SR_IO00       PINMUX_FOR_PSPI0_SR_MODE_1   MDRV_PUSE_PSPI0_CS >,
                <PAD_SR_IO01       PINMUX_FOR_PSPI0_SR_MODE_1   MDRV_PUSE_PSPI0_CLK >,
                <PAD_SR_IO02       PINMUX_FOR_PSPI0_SR_MODE_1   MDRV_PUSE_PSPI0_MOSI0 >,
                <PAD_SR_IO03       PINMUX_FOR_PSPI0_SR_MODE_1   MDRV_PUSE_PSPI0_MOSI1 >,
                <PAD_SR_IO04       PINMUX_FOR_PSPI0_SR_MODE_1   MDRV_PUSE_PSPI0_MOSI2 >,
                <PAD_SR_IO05       PINMUX_FOR_PSPI0_SR_MODE_1   MDRV_PUSE_PSPI0_MOSI3 >,
                <PAD_SR_IO13       PINMUX_FOR_SR0_MCLK_MODE_1  MDRV_PUSE_SR0_MCLK >,
                <PAD_SR_IO14       PINMUX_FOR_I2C1_MODE_6      MDRV_PUSE_I2C1_SCL >,
                <PAD_SR_IO15       PINMUX_FOR_I2C1_MODE_6      MDRV_PUSE_I2C1_SDA >,
                #endif
                #if 0
                //panel
                <PAD_TTL0          PINMUX_FOR_PSPI1_PL_MODE_4   MDRV_PUSE_PSPI1_CS >,
                <PAD_TTL1          PINMUX_FOR_PSPI1_PL_MODE_4   MDRV_PUSE_PSPI1_CLK >,
                <PAD_TTL2          PINMUX_FOR_PSPI1_PL_MODE_4   MDRV_PUSE_PSPI1_MOSI0 >,
                <PAD_TTL3          PINMUX_FOR_PSPI1_PL_MODE_4   MDRV_PUSE_PSPI1_MOSI1 >,
                <PAD_TTL4          PINMUX_FOR_PSPI1_TE_MODE_5   MDRV_PUSE_PSPI1_TE >,
                #endif
                #if 0
                //MCK
                <PAD_SR_I002       PINMUX_FOR_I2S_MCK_MODE_1    MDRV_PUSE_AIO_MCK >,
                #endif

                #if 1
                //SDMMC0
                <PAD_SD_D1              PINMUX_FOR_SDIO_MODE_1          MDRV_PUSE_SDIO0_D1>,
                <PAD_SD_D0              PINMUX_FOR_SDIO_MODE_1          MDRV_PUSE_SDIO0_D0>,
                <PAD_SD_CLK             PINMUX_FOR_SDIO_MODE_1          MDRV_PUSE_SDIO0_CLK>,
                <PAD_SD_CMD             PINMUX_FOR_SDIO_MODE_1          MDRV_PUSE_SDIO0_CMD>,
                <PAD_SD_D3              PINMUX_FOR_SDIO_MODE_1          MDRV_PUSE_SDIO0_D3>,
                <PAD_SD_D2              PINMUX_FOR_SDIO_MODE_1          MDRV_PUSE_SDIO0_D2>,
                <PAD_SD_GPIO0           PINMUX_FOR_GPIO_MODE            MDRV_PUSE_SDIO0_PWR>,
                <PAD_PM_SD_CDZ          PINMUX_FOR_SD_CDZ_MODE_1        MDRV_PUSE_SDIO0_CDZ>,
                #endif
                #if 0
                //mspi0
                <PAD_KEY10              PINMUX_FOR_SPI0_MODE_4          MDRV_PUSE_SPI0_CZ>,
                <PAD_KEY11              PINMUX_FOR_SPI0_MODE_4          MDRV_PUSE_SPI0_CK>,
                <PAD_KEY12              PINMUX_FOR_SPI0_MODE_4          MDRV_PUSE_SPI0_DI>,
                <PAD_KEY13              PINMUX_FOR_SPI0_MODE_4          MDRV_PUSE_SPI0_DO>,
                #endif

                #if 0
                //for eth0 rmii (unuse)
                <PAD_GPIO0               PINMUX_FOR_ETH0_MODE_11                   MDRV_PUSE_ETH_MDIO>,
                <PAD_GPIO1               PINMUX_FOR_ETH0_MODE_11                   MDRV_PUSE_ETH_MDC>,
                <PAD_GPIO2               PINMUX_FOR_ETH0_MODE_11                   MDRV_PUSE_ETH_COL>,
                <PAD_GPIO3               PINMUX_FOR_ETH0_MODE_11                   MDRV_PUSE_ETH_RXD0>,
                <PAD_GPIO4               PINMUX_FOR_ETH0_MODE_11                   MDRV_PUSE_ETH_RXD1>,
                <PAD_GPIO5               PINMUX_FOR_ETH0_MODE_11                   MDRV_PUSE_ETH_TX_CLK>,
                <PAD_GPIO6               PINMUX_FOR_ETH0_MODE_11                   MDRV_PUSE_ETH_TXD0>,
                <PAD_GPIO7               PINMUX_FOR_ETH0_MODE_11                   MDRV_PUSE_ETH_TXD1>,
                <PAD_GPIO8               PINMUX_FOR_ETH0_MODE_11                   MDRV_PUSE_ETH_TX_EN>,
                #endif

                //ttl24_mode_4
                <PAD_KEY7               PINMUX_FOR_TTL24_MODE_4      MDRV_PUSE_TTL_DOUT00>,
                <PAD_KEY6               PINMUX_FOR_TTL24_MODE_4      MDRV_PUSE_TTL_DOUT01>,
                <PAD_KEY5               PINMUX_FOR_TTL24_MODE_4      MDRV_PUSE_TTL_DOUT02>,
                <PAD_KEY4               PINMUX_FOR_TTL24_MODE_4      MDRV_PUSE_TTL_DOUT03>,
                <PAD_KEY3               PINMUX_FOR_TTL24_MODE_4      MDRV_PUSE_TTL_DOUT04>,
                <PAD_KEY2               PINMUX_FOR_TTL24_MODE_4      MDRV_PUSE_TTL_DOUT05>,
                <PAD_KEY1               PINMUX_FOR_TTL24_MODE_4      MDRV_PUSE_TTL_DOUT06>,
                <PAD_KEY0               PINMUX_FOR_TTL24_MODE_4      MDRV_PUSE_TTL_DOUT07>,
                <PAD_TTL20              PINMUX_FOR_TTL24_MODE_4      MDRV_PUSE_TTL_DOUT08>,
                <PAD_TTL19              PINMUX_FOR_TTL24_MODE_4      MDRV_PUSE_TTL_DOUT09>,
                <PAD_TTL18              PINMUX_FOR_TTL24_MODE_4      MDRV_PUSE_TTL_DOUT10>,
                <PAD_TTL17              PINMUX_FOR_TTL24_MODE_4      MDRV_PUSE_TTL_DOUT11>,
                <PAD_TTL16              PINMUX_FOR_TTL24_MODE_4      MDRV_PUSE_TTL_DOUT12>,
                <PAD_TTL15              PINMUX_FOR_TTL24_MODE_4      MDRV_PUSE_TTL_DOUT13>,
                <PAD_TTL14              PINMUX_FOR_TTL24_MODE_4      MDRV_PUSE_TTL_DOUT14>,
                <PAD_TTL13              PINMUX_FOR_TTL24_MODE_4      MDRV_PUSE_TTL_DOUT15>,
                <PAD_TTL12              PINMUX_FOR_TTL24_MODE_4      MDRV_PUSE_TTL_DOUT16>,
                <PAD_TTL11              PINMUX_FOR_TTL24_MODE_4      MDRV_PUSE_TTL_DOUT17>,
                <PAD_TTL10              PINMUX_FOR_TTL24_MODE_4      MDRV_PUSE_TTL_DOUT18>,
                <PAD_TTL9               PINMUX_FOR_TTL24_MODE_4      MDRV_PUSE_TTL_DOUT19>,
                <PAD_TTL8               PINMUX_FOR_TTL24_MODE_4      MDRV_PUSE_TTL_DOUT20>,
                <PAD_TTL7               PINMUX_FOR_TTL24_MODE_4      MDRV_PUSE_TTL_DOUT21>,
                <PAD_TTL6               PINMUX_FOR_TTL24_MODE_4      MDRV_PUSE_TTL_DOUT22>,
                <PAD_TTL5               PINMUX_FOR_TTL24_MODE_4      MDRV_PUSE_TTL_DOUT23>,
                <PAD_TTL4               PINMUX_FOR_TTL24_MODE_4      MDRV_PUSE_TTL_DE>,
                <PAD_TTL3               PINMUX_FOR_TTL24_MODE_4      MDRV_PUSE_TTL_VSYNC>,
                <PAD_TTL2               PINMUX_FOR_TTL24_MODE_4      MDRV_PUSE_TTL_HSYNC>,
                <PAD_TTL1               PINMUX_FOR_TTL24_MODE_4      MDRV_PUSE_TTL_CLK>,

                //i2c0_mode_11
                <PAD_SR_IO14               PINMUX_FOR_I2C0_MODE_7       MDRV_PUSE_I2C0_SCL>,
                <PAD_SR_IO15               PINMUX_FOR_I2C0_MODE_7       MDRV_PUSE_I2C0_SDA>,
                //i2c1_mode_8, and set i2c-padmux = <8> int pioneer-demo.dtsi
                <PAD_KEY8               PINMUX_FOR_I2C1_MODE_8       MDRV_PUSE_I2C1_SCL>,
                <PAD_KEY9               PINMUX_FOR_I2C1_MODE_8       MDRV_PUSE_I2C1_SDA>;

                 #if 0
                //key_pad 7x7, use PAD_KEY0 ~ PAD_KEY13
                <PAD_KEY0           PINMUX_FOR_BT1120_MODE_1      MDRV_PUSE_NA>,
                <PAD_KEY1           PINMUX_FOR_BT1120_MODE_1      MDRV_PUSE_NA>,
                <PAD_KEY2           PINMUX_FOR_BT1120_MODE_1      MDRV_PUSE_NA>,
                <PAD_KEY3           PINMUX_FOR_BT1120_MODE_1      MDRV_PUSE_NA>,
                <PAD_KEY4           PINMUX_FOR_BT1120_MODE_1      MDRV_PUSE_NA>,
                <PAD_KEY5           PINMUX_FOR_BT1120_MODE_1      MDRV_PUSE_NA>,
                <PAD_KEY6           PINMUX_FOR_BT1120_MODE_1      MDRV_PUSE_NA>,
                <PAD_KEY7           PINMUX_FOR_BT1120_MODE_1      MDRV_PUSE_NA>,
                <PAD_KEY8           PINMUX_FOR_BT1120_MODE_1      MDRV_PUSE_NA>,
                <PAD_KEY9           PINMUX_FOR_BT1120_MODE_1      MDRV_PUSE_NA>,
                <PAD_KEY10          PINMUX_FOR_BT1120_MODE_1      MDRV_PUSE_NA>,
                <PAD_KEY11          PINMUX_FOR_BT1120_MODE_1      MDRV_PUSE_NA>,
                <PAD_KEY12          PINMUX_FOR_BT1120_MODE_1      MDRV_PUSE_NA>,
                <PAD_KEY13          PINMUX_FOR_BT1120_MODE_1      MDRV_PUSE_NA>,

                //key_pad 4x4, use PAD_KEY0 ~ PAD_KEY7
                <PAD_KEY0           PINMUX_FOR_BT1120_MODE_2      MDRV_PUSE_NA>,
                <PAD_KEY1           PINMUX_FOR_BT1120_MODE_2      MDRV_PUSE_NA>,
                <PAD_KEY2           PINMUX_FOR_BT1120_MODE_2      MDRV_PUSE_NA>,
                <PAD_KEY3           PINMUX_FOR_BT1120_MODE_2      MDRV_PUSE_NA>,
                <PAD_KEY4           PINMUX_FOR_BT1120_MODE_2      MDRV_PUSE_NA>,
                <PAD_KEY5           PINMUX_FOR_BT1120_MODE_2      MDRV_PUSE_NA>,
                <PAD_KEY6           PINMUX_FOR_BT1120_MODE_2      MDRV_PUSE_NA>,
                <PAD_KEY7           PINMUX_FOR_BT1120_MODE_2      MDRV_PUSE_NA>,

                //key_pad 3x3, use PAD_KEY8 ~ PAD_KEY13
                <PAD_KEY8           PINMUX_FOR_BT1120_MODE_3      MDRV_PUSE_NA>,
                <PAD_KEY9           PINMUX_FOR_BT1120_MODE_3      MDRV_PUSE_NA>,
                <PAD_KEY10          PINMUX_FOR_BT1120_MODE_3      MDRV_PUSE_NA>,
                <PAD_KEY11          PINMUX_FOR_BT1120_MODE_3      MDRV_PUSE_NA>,
                <PAD_KEY12          PINMUX_FOR_BT1120_MODE_3      MDRV_PUSE_NA>,
                <PAD_KEY13          PINMUX_FOR_BT1120_MODE_3      MDRV_PUSE_NA>,
                #endif
            status = "ok"; // ok or disable
            //status = "disable";
        };

    };

};
